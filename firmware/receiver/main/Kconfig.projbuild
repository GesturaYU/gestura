## firmware/receiver/main/Kconfig.projbuild
```kconfig
menu "Gestura CSI receiver (link measurement)"

    choice CSI_OUT_MODE
        prompt "How the receiver delivers CSI lines to the computer"
        default CSI_OUT_SERIAL

        config CSI_OUT_SERIAL
            bool "USB serial (wired)"

        config CSI_OUT_UDP
            bool "UDP over Wi-Fi"
    endchoice

    config CSI_WIFI_SSID
        string "Access point name (UDP mode)"
        depends on CSI_OUT_UDP
        default ""

    config CSI_WIFI_PASSWORD
        string "Access point password (UDP mode)"
        depends on CSI_OUT_UDP
        default ""

    config CSI_UDP_HOST
        string "Computer IP address (UDP mode)"
        depends on CSI_OUT_UDP
        default ""

    config CSI_TEST_UDP_ONLY
        bool "Test: no CSI, no ESP-NOW, only send numbered UDP datagrams (UDP mode)"
        depends on CSI_OUT_UDP
        default n

    config CSI_UDP_PORT
        int "Computer UDP port (UDP mode)"
        depends on CSI_OUT_UDP
        default 5005

endmenu
```

## firmware/receiver/sdkconfig.defaults
```kconfig
CONFIG_ESP_CONSOLE_UART_CUSTOM=y
CONFIG_ESP_CONSOLE_UART_BAUDRATE=921600
CONFIG_ESP_TASK_WDT_TIMEOUT_S=30
CONFIG_ESP_WIFI_DYNAMIC_RX_BUFFER_NUM=128
CONFIG_ESP_WIFI_CSI_ENABLED=y
CONFIG_ESP_WIFI_AMPDU_TX_ENABLED=n
CONFIG_ESP_WIFI_DYNAMIC_TX_BUFFER_NUM=128
```
